## CMakeLists.txt
```
cmake_minimum_required(VERSION 3.20.0)
find_package(Zephyr REQUIRED HINTS $ENV{ZEPHYR_BASE})

project(ncs)

target_sources(app PRIVATE src/main.c src/cmdproc.c src/funcs.c)
```

## prj.conf
```kconfig
CONFIG_PRINTK=y
CONFIG_TIMESLICE_SIZE=10
CONFIG_TIMESLICE_PRIORITY=0
CONFIG_GPIO=y
CONFIG_SERIAL=y
CONFIG_UART_ASYNC_API=y

CONFIG_ADC=y
CONFIG_MULTITHREADING=y
CONFIG_CBPRINTF_FP_SUPPORT=y
```

## src/main.c
```c
/** @file main.c
 * @brief Main function definition
 * 
 * @author Gonçalo Peralta & João Alvares
 * @date 03 June 2024
 * @bug Line 204, uart_tx() function not working as expected, it only send some character from the tx_buf so it was replaced with printk()
*/

#include <zephyr/kernel.h>
#include <zephyr/device.h>
#include <zephyr/drivers/gpio.h>
#include <zephyr/sys/util.h>
#include <zephyr/sys/printk.h>
#include <zephyr/drivers/uart.h>
#include <zephyr/devicetree.h>
#include <zephyr/drivers/adc.h>

#include <string.h>
#include <stdlib.h>
#include <math.h>

#include "../includes/cmdproc.h"
#include "../includes/funcs.h"

// Config ADC
#define SLEEP_TIME_MS 	1000
#define ADC_NODE		DT_NODELABEL(adc)		// DT_N_S_soc_S_adc_40007000
#define ADC_RESOLUTION	10
#define ADC_CHANNEL 	0
#define ADC_PORT 		SAADC_CH_PSELP_PSELP_AnalogInput0	// AIN0
#define ADC_REFERENCE	ADC_REF_INTERNAL					// 0.6v
#define ADC_GAIN 		ADC_GAIN_1_5						// ADC_REFERENCE*5
static const struct device *adc_dev = DEVICE_DT_GET(ADC_NODE);
struct adc_channel_cfg chl0_cfg = {
	.gain = ADC_GAIN,
	.reference = ADC_REFERENCE,
	.acquisition_time = ADC_ACQ_TIME_DEFAULT,
	.channel_id = ADC_CHANNEL,
#ifdef	CONFIG_ADC_NRFX_SAADC
	.input_positive = ADC_PORT
#endif
};
int16_t sample_buffer[4];
struct adc_sequence sequence = {
	/* canais individuais serão adicionados abaixo */
	.channels 	 = BIT(ADC_CHANNEL),
	.buffer		 = sample_buffer,
	
	.buffer_size = sizeof(sample_buffer),
	.resolution  = ADC_RESOLUTION
};

// Config threads
#define THREAD0_PRIORITY 7
#define THREAD1_PRIORITY 7
K_MUTEX_DEFINE(test_mutex);

// Buttons 1-4
const struct gpio_dt_spec button_1 = GPIO_DT_SPEC_GET_OR(DT_ALIAS(sw0), gpios, {0});
const struct gpio_dt_spec button_2 = GPIO_DT_SPEC_GET_OR(DT_ALIAS(sw1), gpios, {0});
const struct gpio_dt_spec button_3 = GPIO_DT_SPEC_GET_OR(DT_ALIAS(sw2), gpios, {0});
const struct gpio_dt_spec button_4 = GPIO_DT_SPEC_GET_OR(DT_ALIAS(sw3), gpios, {0});

// LEDs 1-4
const struct gpio_dt_spec led_1 = GPIO_DT_SPEC_GET(DT_ALIAS(led0), gpios);
const struct gpio_dt_spec led_2 = GPIO_DT_SPEC_GET_OR(DT_ALIAS(led1), gpios, {0});		
const struct gpio_dt_spec led_3 = GPIO_DT_SPEC_GET_OR(DT_ALIAS(led2), gpios, {0});		
const struct gpio_dt_spec led_4 = GPIO_DT_SPEC_GET_OR(DT_ALIAS(led3), gpios, {0});		

// UART
#define STACKSIZE 2048
#define RECEIVE_BUFF_SIZE 20
#define TRANSMIT_BUFF_SIZE 50
#define RECEIVE_TIMEOUT 100
const struct device *uart = DEVICE_DT_GET(DT_NODELABEL(uart0));
static uint8_t tx_buf[TRANSMIT_BUFF_SIZE] = "[UART] This is a UART test msg\n";
static uint8_t rx_buf[RECEIVE_BUFF_SIZE] = {0};

// Vars
RTDB database;
int period = 5000; // Frequency of update of RTDB
void updateFreq(int x){
	period = x;
}

// UART Call-back, in case the buffer gets full. rx_buf will act as a circular buffer
static void uart_cb(const struct device *dev, struct uart_event *evt, void *user_data){
	switch(evt->type){
		case UART_TX_DONE:
			break;
		case UART_RX_DISABLED:
			uart_rx_enable(dev, rx_buf, sizeof rx_buf, RECEIVE_TIMEOUT);
			break;
		default:
			break;
	}
}

// Thread de atualização da RTDB
void thread0(void){
    initRTDB(&database);
	int err;
	k_busy_wait(50000); // Wait for TH1 to initilize Hardware
	printk("[TH0] Ready\n");
	while(1){
		err = adc_read(adc_dev, &sequence);
		if(err != 0){
			printk("ADC reading failed with error %d. \n", err);
		}

		k_mutex_lock(&test_mutex, K_FOREVER);	// Refreshing the RTDB Lock the access

		// Buttons
		database.but[0] = gpio_pin_get_dt(&button_1);
		database.but[1] = gpio_pin_get_dt(&button_2);
		database.but[2] = gpio_pin_get_dt(&button_3);
		database.but[3] = gpio_pin_get_dt(&button_4);
		// LEDs
		gpio_pin_set_dt(&led_1, database.led[0]);
		gpio_pin_set_dt(&led_2, database.led[1]);
		gpio_pin_set_dt(&led_3, database.led[2]);
		gpio_pin_set_dt(&led_4, database.led[3]);
		// Analog Read
		database.anRaw = sample_buffer[0];
		database.anVal = (float)database.anRaw * 3/(pow(2, ADC_RESOLUTION)); // Swaping scales where 3 = VDD

		k_mutex_unlock(&test_mutex);			// Refresh done, time to unlock

		k_busy_wait(period);
	}
}

// Thread para enviar e receber códigos
// Commands
	// # B [CS] ! 					- Read button state
	// # L [1/2/3/4] [CS] ! 		- Toggle LED state (Ligado ou desligado)
	// # A [CS] ! 					- Read Analog sensor (Temperatura)
	// # U [00] [CS] !	 			- Change frequecy of update of the in/out digital signals of RTDB
	// So fiz os de cima
	// # S [0000] [CS] ! 			- Change frequecy of sampling of analog input signal
	// # P [CS] ! 					- Toggle Analog reading mode
void thread1(void){
	if(!initHardware()){
        printk("[TH1] Error initilizing Hardware\n");
    }
	int endSym = 0; 	// Holds the position of the EOF_SYM (!)
	int startSym = 0;	// Holds the position of the SOF_SYM (#)
	int flag = 0;		// Goes to 1 if a # and ! are found
	int err = 0;		// Error var handler
	char resp[RECEIVE_BUFF_SIZE];	// Response command
	char cmd[RECEIVE_BUFF_SIZE] = "\0";	// Received command
	char c = '0';		// Dummy char
	memset(rx_buf, 0, sizeof(rx_buf));
	memset(tx_buf, 0, sizeof(tx_buf));

	printk("[TH1] Ready\n");
    while(1){
		endSym = 0; startSym = 0; flag = 0; // Clear all vars 
		
		// Look for a EOF_SYM and store its position
		// if found look for a SOF_SYM and store its position
		// if also found means theres a possible command in the buffer so set flag to 1
		// It also takes into account that rx_buf is circular
		for(int i = 0; i < RECEIVE_BUFF_SIZE; i++){
			if(rx_buf[i] == EOF_SYM){
				endSym = i;
				startSym = endSym;
				for(int j = 0; j < RECEIVE_BUFF_SIZE; j++){
					if(rx_buf[startSym] == SOF_SYM){
						flag = 1;
						break;
					}
					startSym--;
					startSym = startSym == -1 ? RECEIVE_BUFF_SIZE-1 : startSym;
				}
				break;
			}
		}

		// If theres a command start processing
		if(flag == 1){
			// Next for loop creates a substring from the rx_buf with only the Command chars (from # to !)
			for(int i = startSym; i != endSym+1; i++){
				if(i == RECEIVE_BUFF_SIZE){
					i = 0;
				}
				c = rx_buf[i];
				strncat(cmd, &c, 1);
				rx_buf[i] = 'X'; // Mark the command in rx_buf with X's
			}

			// Add a NULL terminator to finalize the string
			if(endSym > startSym){
				cmd[endSym+1] = '\0';
			}
			else{
				cmd[RECEIVE_BUFF_SIZE-startSym+endSym+1] = '\0';
			}

			// Proccess the command
			err = cmdProcessor(cmd, resp, &database);
			if(err == SUCCESS){
				strcpy(tx_buf, resp);
				printk("%s\n", tx_buf); // uart_tx(uart, tx_buf, sizeof(tx_buf), SYS_FOREVER_MS); does not work as expected for some reason
			} else{
				consoleLog(err);
			}

			memset(cmd, 0, sizeof(cmd));
			memset(tx_buf, 0, sizeof(cmd));
			flag = 0;	// Command was processed so set the flag to zero again
		}
		
		// for(int i = 0; i < RECEIVE_BUFF_SIZE; i++){
		// 	printk("%c", rx_buf[i]);
		// }
		// printk("\n");
		k_busy_wait(5000);
    }
}

K_THREAD_DEFINE(thread0_id, STACKSIZE, thread0, NULL, NULL, NULL, THREAD0_PRIORITY, 0, 0);
K_THREAD_DEFINE(thread1_id, STACKSIZE, thread1, NULL, NULL, NULL, THREAD1_PRIORITY, 0, 0);

int initHardware(){
    int returnValue = 0;

	// Check if the buttons are ready
	if(!gpio_is_ready_dt(&button_1)){
		printk("[NCS] Error: button device %s is not ready\n", button_1.port->name);
		return 0;
	}
	if(!gpio_is_ready_dt(&button_2)){
		printk("[NCS] Error: button device %s is not ready\n", button_2.port->name);
		return 0;
	}
	if(!gpio_is_ready_dt(&button_3)){
		printk("[NCS] Error: button device %s is not ready\n", button_3.port->name);
		return 0;
	}
	if(!gpio_is_ready_dt(&button_4)){
		printk("[NCS] Error: button device %s is not ready\n", button_4.port->name);
		return 0;
	}
	
	// Configure the buttons as inputs
	returnValue = gpio_pin_configure_dt(&button_1, GPIO_INPUT);
	if(returnValue != 0){
		printk("[NCS] Error %d: failed to configure %s pin %d\n", returnValue, button_1.port->name, button_1.pin);
		return 0;
	}
	returnValue = gpio_pin_configure_dt(&button_2, GPIO_INPUT);
	if(returnValue != 0){
		printk("[NCS] Error %d: failed to configure %s pin %d\n", returnValue, button_2.port->name, button_2.pin);
		return 0;
	}
	returnValue = gpio_pin_configure_dt(&button_3, GPIO_INPUT);
	if(returnValue != 0){
		printk("[NCS] Error %d: failed to configure %s pin %d\n", returnValue, button_3.port->name, button_3.pin);
		return 0;
	}
	returnValue = gpio_pin_configure_dt(&button_4, GPIO_INPUT);
	if(returnValue != 0){
		printk("[NCS] Error %d: failed to configure %s pin %d\n", returnValue, button_4.port->name, button_4.pin);
		return 0;
	}
	printk("[NCS] Set up button_1 at %s pin %d\n", button_1.port->name, button_1.pin);
	printk("[NCS] Set up button_2 at %s pin %d\n", button_2.port->name, button_2.pin);
	printk("[NCS] Set up button_3 at %s pin %d\n", button_3.port->name, button_3.pin);
	printk("[NCS] Set up button_4 at %s pin %d\n", button_4.port->name, button_4.pin);

	// Check if the LEDs are ready
	if(led_1.port && !gpio_is_ready_dt(&led_1)){
		printk("[NCS] Error %d: LED_1 device %s is not ready\n", returnValue, led_1.port->name);
		return 0;
	}
	if(led_2.port && !gpio_is_ready_dt(&led_2)){
		printk("[NCS] Error %d: LED_2 device %s is not ready\n", returnValue, led_2.port->name);
		return 0;
	}
	if(led_3.port && !gpio_is_ready_dt(&led_3)){
		printk("[NCS] Error %d: LED_3 device %s is not ready\n", returnValue, led_3.port->name);
		return 0;
	}
	if(led_4.port && !gpio_is_ready_dt(&led_4)){
		printk("[NCS] Error %d: LED_4 device %s is not ready\n", returnValue, led_4.port->name);
		return 0;
	}

	// Configuring LEDs as outputs
	returnValue = gpio_pin_configure_dt(&led_1, GPIO_OUTPUT);
	if(returnValue != 0){
		printk("[NCS] Error %d: failed to configure LED_1 device %s pin %d\n", returnValue, led_1.port->name, led_1.pin);
		return 0;
	} else{
		printk("[NCS] Set up LED_1 at %s pin %d\n", led_1.port->name, led_1.pin);
	}
	returnValue = gpio_pin_configure_dt(&led_2, GPIO_OUTPUT);
	if(returnValue != 0){
		printk("[NCS] Error %d: failed to configure LED_1 device %s pin %d\n", returnValue, led_2.port->name, led_2.pin);
		return 0;
	} else{
		printk("[NCS] Set up LED_2 at %s pin %d\n", led_2.port->name, led_2.pin);
	}
	returnValue = gpio_pin_configure_dt(&led_3, GPIO_OUTPUT);
	if(returnValue != 0){
		printk("[NCS] Error %d: failed to configure LED_1 device %s pin %d\n", returnValue, led_3.port->name, led_3.pin);
		return 0;
	} else{
		printk("[NCS] Set up LED_3 at %s pin %d\n", led_3.port->name, led_3.pin);
	}
	returnValue = gpio_pin_configure_dt(&led_4, GPIO_OUTPUT);
	if(returnValue != 0){
		printk("[NCS] Error %d: failed to configure LED_1 device %s pin %d\n", returnValue, led_4.port->name, led_4.pin);
		return 0;
	} else{
		printk("[NCS] Set up LED_4 at %s pin %d\n", led_4.port->name, led_4.pin);
	}

	// Turning LEDs off
	gpio_pin_set_dt(&led_1, 0);
	gpio_pin_set_dt(&led_2, 0);
	gpio_pin_set_dt(&led_3, 0);
	gpio_pin_set_dt(&led_4, 0);

    // Check if UART is ready
    if(!device_is_ready(uart)){
        printk("[NCS] Error: UART device not ready\n");
    }
    printk("[NCS] Device UART ready\n");
	returnValue = uart_callback_set(uart, uart_cb, NULL);
	if(returnValue){
		printk("[NCS] Error: Failled to set up UART callback\n");
		return 0;
	}
	returnValue = uart_tx(uart, tx_buf, sizeof(tx_buf), SYS_FOREVER_MS);
	if(returnValue){
		printk("[NCS] Error: Failled to send TX buffer\n");
		return 0;
	}
	returnValue = uart_rx_enable(uart, rx_buf, sizeof(rx_buf), RECEIVE_TIMEOUT);
	if(returnValue){
		printk("[NCS] Error: Failled to set up UART\n");
		return 0;
	}
	printk("[NCS] UART device ready\n");

	// Check if ADC is ready
	if(!device_is_ready(adc_dev)){
		printk("[NCS] Error: ADC device not ready\n");
	}
	returnValue = adc_channel_setup(adc_dev, &chl0_cfg);
	if(returnValue != 0){
		printk("[NCS] Error: ADC adc_channel_setup failed with error %d.\n", returnValue);
	}
	printk("[NCS] ADC device ready\n");
	return 1;
}
```

## src/cmd.c
```c
#include <zephyr/kernel.h>
#include <zephyr/device.h>
#include <zephyr/drivers/gpio.h>
#include <zephyr/sys/util.h>
#include <zephyr/sys/printk.h>
#include <zephyr/drivers/uart.h>

#include <stdio.h>
#include <ctype.h>
#include <stdlib.h>
#include <string.h>
#include <math.h>

#include "../includes/cmd.h"
#include "../includes/main.h"

extern const struct gpio_dt_spec button_1;
extern const struct gpio_dt_spec button_2;
extern const struct gpio_dt_spec button_3;
extern const struct gpio_dt_spec button_4;

extern const struct gpio_dt_spec led_1;
extern const struct gpio_dt_spec led_2;
extern const struct gpio_dt_spec led_3;
extern const struct gpio_dt_spec led_4;

extern int timer;

static unsigned char UARTRxBuffer[UART_RX_SIZE];
static unsigned char rxBufLen = 0; 
static unsigned char UARTTxBuffer[UART_TX_SIZE];
static unsigned char txBufLen = 0;

int cmdProcessor(RTDB *database){
	int i, sizeCMD = 0;
	unsigned char type = 0; // Led number
	unsigned char expectedChecksum = 0;
	char receivedChecksum[4], checksum[4];
	char txCmd[UART_TX_SIZE];
	unsigned char val[4];

	if(rxBufLen == 0){
		return EMPTY_BUFFER;
	}
		
	i = 0;
	if(UARTRxBuffer[i] != SOF_SYM){
		return MISSING_SOF;
	}
	
	
	if(i < rxBufLen){
		switch(UARTRxBuffer[i+1]) {
            // Commands
            // # B [CS] ! 					- Read button state
            // # L [1/2/3/4] [1/0] [CS] ! 	- Set LED state
            // # A [CS] ! 					- Read Analog sensor
            // # U [0000] [CS] !	 		- Change frequecy of update of the in/out digital signals of RTDB
            // # S [0000] [CS] ! 			- Change frequecy of sampling of analog input signal
            // # P [CS] ! 					- Toggle Analog reading mode
			case 'B': // #A[CS]!
				// Validate frame structure
				if(UARTRxBuffer[i+5] != EOF_SYM){
					resetRxBuffer();
					return MISSING_EOF;
				}
				
				// Validate checksum
				expectedChecksum = calcChecksum(&(UARTRxBuffer[i+1]), 1);
				receivedChecksum[0] = UARTRxBuffer[i+2];
				receivedChecksum[1] = UARTRxBuffer[i+3];
				receivedChecksum[2] = UARTRxBuffer[i+4];
				if(atoi(receivedChecksum) != expectedChecksum){
					clear_rx_cmd();
					return WRONG_CS;
				}

				if (database->but[0]) {

				}
				// Create a response command
				txCmd[0] = '#'; 		 // SOF
				txCmd[1] = 'b';  		 // b
				txCmd[2] = database->but[0] ? '1' : '0';
				txCmd[3] = database->but[1] ? '1' : '0';
				txCmd[4] = database->but[2] ? '1' : '0';
				txCmd[5] = database->but[3] ? '1' : '0';
                sprintf(checksum, "%03d", calcChecksum((unsigned char*)&(txCmd[1]), 5));
				txCmd[6] = checksum[0]; // CS
				txCmd[7] = checksum[1]; // CS
				txCmd[8] = checksum[2]; // CS
				txCmd[9] = '!'; // EOF
				sizeCMD = 10;

				// Send through the Transmiter buffer
				clear_tx_cmd();
				for(int j = 0; j < sizeCMD; j++){
					txChar(txCmd[j]);
				}
				
				clear_rx_cmd();
				return SUCCESS;
	
			case 'L': // #L[1/2/3/4][CS]!
				// Validate frame structure
				type = UARTRxBuffer[i+2];
				int numero = type - '0';
				if(numero<1 || numero>4){ // #L[1/2/3/4],,,!
					clear_rx_cmd();
					return MISSING_SENSOR_TYPE;
				}
				if(UARTRxBuffer[i+6] != EOF_SYM){
					resetRxBuffer();
					return MISSING_EOF;
				}

				// Validate Checksum
				receivedChecksum[0] = UARTRxBuffer[i+3];
				receivedChecksum[1] = UARTRxBuffer[i+4];
				receivedChecksum[2] = UARTRxBuffer[i+5];
				expectedChecksum = atoi(receivedChecksum);
				if(expectedChecksum != calcChecksum(&(UARTRxBuffer[i+1]), 2)){
					clear_rx_cmd();
					return WRONG_CS;
				}
				
				// Toggle Led
				if (numero == 1) {
					database->led[0] = !database->led[0];
				}
				else if (numero == 2) {
					database->led[1] = !database->led[1];
				}
				else if (numero == 3) {
					database->led[2] = !database->led[2];
				}
				else {
					database->led[3] = !database->led[3];
				}

				// Create a response command
				txCmd[0] = '#';  // SOF
				txCmd[1] = 'l';  // p
				sprintf(checksum, "%03d", calcChecksum((unsigned char*)&(txCmd[1]), 1));
				txCmd[2] = checksum[0]; // CS
				txCmd[3] = checksum[1]; // CS
				txCmd[4] = checksum[2]; // CS
				txCmd[5] = '!'; // EOF
				sizeCMD = 6;

				// Send through the Transmiter buffer
				clear_tx_cmd();
				for(int j = 0; j < sizeCMD; j++){
					txChar(txCmd[j]);
				}

				clear_rx_cmd();
				return SUCCESS;

			case 'A': // #A[CS]!
				// Validate frame structure
				if(UARTRxBuffer[i+5] != EOF_SYM){
					resetRxBuffer();
					return MISSING_EOF;
				}
				receivedChecksum[0] = UARTRxBuffer[i+2];
				receivedChecksum[1] = UARTRxBuffer[i+3];
				receivedChecksum[2] = UARTRxBuffer[i+4];
				expectedChecksum = calcChecksum(&(UARTRxBuffer[i+1]), 1);
				if(atoi(receivedChecksum) != expectedChecksum){
					clear_rx_cmd();
					return WRONG_CS;
				}
				
				// Valor anVal da ADC
				if (database->anVal >= 100) {
        			val[0] = (database->anVal / 100) + '0';
        			database->anVal %= 100;
    			}
				else {
					val[0] = '0';
				}
    			if (database->anVal >= 10) {
        			val[1] = (database->anVal / 10) + '0';
        			database->anVal %= 10;
    			}
				else {
					val[1] = '1';
				}
    			val[2] = database->anVal + '0';

				// Create a response command
				txCmd[0] = '#';  // SOF
				txCmd[1] = 'a';  // a
				txCmd[2] = val[0];
				txCmd[3] = val[1];
				txCmd[4] = val[2];
				sprintf(checksum, "%03d", calcChecksum((unsigned char*)&(txCmd[1]), 4));
				txCmd[5] = checksum[0]; // CS
				txCmd[6] = checksum[1]; // CS
				txCmd[7] = checksum[2]; // CS
				txCmd[8] = '!'; // EOF
				sizeCMD = 9;

				// Send through the Transmiter buffer
				clear_tx_cmd();
				for(int j = 0; j < sizeCMD; j++){
					txChar(txCmd[j]);
				}

				clear_rx_cmd();
				return SUCCESS;
			case 'U': // #U[val][CS]!
				// Validate frame structure
				if(UARTRxBuffer[i+7] != EOF_SYM){
					resetRxBuffer();
					return MISSING_EOF;
				}
				// Validate Checksum
				receivedChecksum[0] = UARTRxBuffer[i+4];
				receivedChecksum[1] = UARTRxBuffer[i+5];
				receivedChecksum[2] = UARTRxBuffer[i+6];
				expectedChecksum = calcChecksum(&(UARTRxBuffer[i+1]), 3);
				if(atoi(receivedChecksum) != expectedChecksum){
					clear_rx_cmd();
					return WRONG_CS;
				}
				
				int digito_x = UARTRxBuffer[i+2] - '0';
				int digito_x1 = UARTRxBuffer[i+3] - '0';
				timer = digito_x*10 + digito_x1;

				//printk ("Tempo de espera: %d\n", timer);
				// Create a response command
				txCmd[0] = '#';  // SOF
				txCmd[1] = 'u';  // u
				txCmd[2] = UARTRxBuffer[i+2];
				txCmd[3] = UARTRxBuffer[i+3];
				sprintf(checksum, "%03d", calcChecksum((unsigned char*)&(txCmd[1]), 3));
				txCmd[4] = checksum[0]; // CS
				txCmd[5] = checksum[1]; // CS
				txCmd[6] = checksum[2]; // CS
				txCmd[7] = '!'; // EOF
				sizeCMD = 8;

				// Send through the Transmiter buffer
				clear_tx_cmd();
				for(int j = 0; j < sizeCMD; j++){
					txChar(txCmd[j]);
				}
				clear_rx_cmd();
				return SUCCESS;
			default:
				clear_rx_cmd();
				return UNKNOWN_CMD;				
		}
	}
	resetRxBuffer();
	return SUCCESS;
}

unsigned char calcChecksum(unsigned char *buf, int nbytes){
	unsigned char checksum = 0;
	for(int i = 0; i < nbytes; i++){ // computing expected checksum
		checksum += buf[i];
	}

	return checksum;
}

int rxChar(unsigned char car){
	if(rxBufLen < UART_RX_SIZE){
		UARTRxBuffer[rxBufLen] = car;
		rxBufLen += 1;
		return SUCCESS;
	}
	return RX_FULL;
}

int txChar(unsigned char car){
	if(txBufLen < UART_TX_SIZE){
		UARTTxBuffer[txBufLen] = car;
		txBufLen += 1;
		return SUCCESS;
	}
	return TX_FULL;
}

void resetRxBuffer(void){
	rxBufLen = 0;
	return;
}

void resetTxBuffer(void){
	txBufLen = 0;
	return;
}

void getTxBuffer(unsigned char *buf, int *len){
	*len = txBufLen;
	if(txBufLen > 0){
		memcpy(buf, UARTTxBuffer, *len);
	}
	return;
}

void getRxBuffer(unsigned char *buf, int *len){
	*len = rxBufLen;
	if(rxBufLen > 0){
		memcpy(buf, UARTRxBuffer, *len);
	}
	return;
}

int clear_rx_cmd(){
	if(rxBufLen == 0){
		return EMPTY_BUFFER;
	}
	int i = 0;
	while(UARTRxBuffer[i] != '#'){
		i++;
	}
	int j = i;
	while(UARTRxBuffer[j] != '!'){
		j++;
	}
	for(int k = i; k <= j; k++){
		UARTRxBuffer[k] = '\0';
	}
	rxBufLen = i;

	return SUCCESS;
}

int clear_tx_cmd(){
	if(txBufLen == 0){
		return EMPTY_BUFFER;
	}
	int i = 0;
	while(UARTTxBuffer[i] != '#'){
		i++;
	}
	int j = i;
	while(UARTTxBuffer[j] != '!'){
		j++;
	}
	for(int k = i; k <= j; k++){
		UARTTxBuffer[k] = '\0';
	}
	txBufLen = i;

	return SUCCESS;
}

void print_rx(){
	printk("\n ------ Code ------ \n {");
	for(int i = 0; UARTRxBuffer[i] != '\0'; i++){
		printk("'%c',", UARTRxBuffer[i]);
	}
	memset(UARTRxBuffer, 0, sizeof(UARTRxBuffer));
}

void print_tx(){
	printk("\n ------ Response ------ \n");
	printk("{");

	for(int i = 0; UARTTxBuffer[i] != '\0'; i++){
		printk("'%c'", UARTTxBuffer[i]);
		if (UARTTxBuffer[i] != '!') {
			printk(",");
		}
	}

	printk("}\n");
}
```

## src/cmd.h
```c
/** @file cmd.h
 * @brief Yields the functions and the structures of the program. Based on the provided base code
 *
 * This file has provides a set of functions to process a command in the UART.
 * 
 * @author Gonçalo Peralta & João Alvares
 * @date 30 March 2024
 * @bug No known bugs.
 */

#ifndef CMD_H_
#define CMD_H_

#include "main.h"

#define UART_RX_SIZE 20 	/**< Maximum size of the RX buffer */ 
#define UART_TX_SIZE 20 	/**< Maximum size of the TX buffer */ 
#define SOF_SYM '#'	        /**< Start of Frame Symbol */
#define EOF_SYM '!'         /**< End of Frame Symbol */
#define HIST_SIZE 20        /**< Maximum size for the History variables */

#define SUCCESS 1                   /**< Operation completed without errors */
#define MISSING_SOF -100            /**< Missing start of frame caracter '#' */
#define MISSING_EOF -101            /**< Missing end of frame caracter '!' */
#define MISSING_SENSOR_TYPE -102    /**< Missing sensor type for 'P' command */
#define EMPTY_BUFFER -103           /**< Rx Buffer is empty */
#define WRONG_CS -104               /**< Expected checksum is not equal to the received one */
#define RX_FULL -105                /**< Rx Buffer is full */
#define TX_FULL -106                /**< Tx Buffer is full */
#define UNKNOWN_CMD -107            /**< Command not identified */
#define BAD_PARAMETER -108          /**< Reading out of bounds */
#define OUT_OF_READING -109         /**< No more readings available*/

/**
 * @brief Processes the characters in the Rx buffer looking for a command
 * 
 * The structure of a command in the Rx Buffer is: "# CMD CS !" (without the spaces) <br>
 * <ul>
 *      <li> # &rarr; Start of frame <br>
 *      <li> CMD &rarr; Type of command 'B'/'L'/'A'/'U', more information bellow <br>
 *      <li> CS &rarr; Modulo 256 3-bit checksum of the bytes in the CMD <br>
 *      <li> ! &rarr; End of frame <br>
 * </ul>     
 * Depending on the provided CMD a reponse command is sent to the Tx Buffer <br>
 * Types of CMD: <br>
 * <ul>
 *       <li> 'B' &rarr; Reads the state of all Buttons (1-4). A command is sent to the Tx Buffer with structure "# CMD DATA CS !" where: <br>
 *       <ul>
 *          <li> CMD &rarr; in this case will be the byte 'b' <br>
 *          <li> DATA &rarr; containts 4 bytes of type '1' (pressed) or '0' (not pressed) for each button 1 to 4 <br>
 *          <li> CS &rarr; checksum of CMD and DATA bytes <br>
 *       </ul>
 *       <li> 'L','[1/2/3/4]' &rarr; Toggles the state of the provided LED number. A command is sent to the Tx Buffer with structure "# CMD CS !" where: <br>
 *       <ul>
 *          <li> CMD &rarr; 'l' <br>
 *       </ul>
 *       <li> 'A' &rarr; Reads the analog sensor. A command is sent to the Tx Buffer with structure "# CMD DATA CS !" where: <br>
 *       <ul>
 *          <li> CMD &rarr; 'a' <br>
 *          <li> DATA &rarr; 3 bytes corresponding to the value read <br>
 *       </ul>
 *       <li> 'U','[x/x]' &rarr; Change frequecy of update of the in/out digital signals of RTDB to xx MHz. A command is sent to the Tx Buffer with structure "# CMD CS !" where: <br>
 *       <ul>
 *          <li> CMD &rarr; 'u' <br>
 *          <li> DATA &rarr; 'xx' (same as the provided one) <br>
 *       </ul>
 *  </ul>
 * @return EMPTY_BUFFER if Rx Buffer is empty, MISSING_EOF if '!' is not found, WRONG_CS if checksum is wrong, MISSING_SENSOR_TYPE sensor type is not found (for 'P' CMD), MISSING_SOF if a '#' is not found and UNKNOWN_CMD if the CMD is not identified
 */
int cmdProcessor(RTDB *database);

/**
 * @brief Adds a character to the Rx Buffer
 * 
 * @param[in] car character to be added
 * @return RX_FULL if Rx Buffer is full, SUCCESS if no error occours 
*/
int rxChar(unsigned char car);

/**
 * @brief Adds a character to the Tx Buffer
 * 
 * @param[in] car character to be added
 * @return TX_FULL if Tx Buffer is full, SUCCESS if no error occours 
*/
int txChar(unsigned char car);

/**
 * @brief Resets the Rx Buffer
 * 
 * Calling this function sets the rxBufLen to zero
 * @return void
*/
void resetRxBuffer(void);

/**
 * @brief Resets the Tx Buffer
 * 
 * Calling this function sets the txBufLen to zero
 * @return void
*/
void resetTxBuffer(void);

/**
 * @brief Returns the data on the Tx Buffer and length
 * 
 * Sets the contents of buf to the same as the Tx Buffer and len to the length of the buffer
 * @param[in] buf buffer to copy the Tx Buffer contents
 * @param[in] len buffer variable that gets set to the length of the Tx Buffer
 * @return void
*/
void getTxBuffer(unsigned char * buf, int * len);

/**
 * @brief Returns the data on the Rx Buffer and length
 * 
 * Sets the contents of buf to the same as the Rx Buffer and len to the length of the buffer
 * @param[in] buf buffer to copy the Rx Buffer contents
 * @param[in] len buffer variable that gets set to the length of the Rx Buffer
 * @return void
*/
void getRxBuffer(unsigned char * buf, int * len);

/**
 * @brief Computes the modulo 256 checksum of a given number of bytes
 * 
 * Calculates the modulo 256 sum in ASCII of the first nbytes of the provided buffer. Returns the value. 
 * @param[in] buf buffer with the caracters to calculate the checksum
 * @param[in] nbytes number of bytes to get into account on the sum
 * @return unsigned char with the value of the checksum
*/
unsigned char calcChecksum(unsigned char * buf, int nbytes);

/**
 * @brief Clears the first command in the Rx Buffer
 * 
 * Looks for the first command in the Rx Buffer and clears it. 
 * @return EMPTY_BUFFER if buffer len is zero, SUCCESS if no error
*/
int clear_rx_cmd();

/**
 * @brief Clears the first command in the Tx Buffer
 * 
 * Looks for the first command in the Tx Buffer and clears it. 
 * @return EMPTY_BUFFER if buffer len is zero, SUCCESS if no error
*/
int clear_tx_cmd();

/**
 * @brief Prints the contens of the Rx Buffer
 * 
 * Prints to the terminal all bytes in the Rx Buffer.
 * @return void
*/
void print_rx();

/**
 * @brief Prints the contens of the Tx Buffer
 * 
 * Prints to the terminal all bytes in the Tx Buffer.
 * @return void
*/
void print_tx();

#endif
```

## src/cmdproc.c
```c
/** @file cmdproc.c
 * @brief Definition of the function for the Command Processor module
 * 
 * @author Gonçalo Peralta & João Alvares
 * @date 03 June 2024
 * @bug No known bugs.
*/

#include <zephyr/kernel.h>
#include <zephyr/device.h>
#include <zephyr/drivers/gpio.h>
#include <zephyr/sys/util.h>
#include <zephyr/sys/printk.h>
#include <zephyr/drivers/uart.h>
#include <zephyr/devicetree.h>
#include <zephyr/drivers/adc.h>
#include <stdio.h>
#include <ctype.h>
#include <stdlib.h>
#include <string.h>
#include <math.h>
#include "../includes/cmdproc.h"
#include "../includes/funcs.h"

extern struct k_mutex test_mutex;


int cmdProcessor(char *cmd, char *resp, RTDB *database){
	unsigned char expectedChecksum = 0;
	char receivedChecksum[4], checksum[4];
	int var = 0;

	switch(cmd[1]){
		case 'B': // # B [CS] ! - Read button state, resp: # b [0/0/0/0] [CS] !
			// Validate frame structure
			if(cmd[5] != EOF_SYM){
				return MISSING_EOF;
			}
			
			// Validate checksum
			expectedChecksum = calcChecksum(&(cmd[1]), 1);
			sprintf(receivedChecksum, "%c%c%c", cmd[2], cmd[3], cmd[4]);
			if(atoi(receivedChecksum) != expectedChecksum){
				return WRONG_CS;
			}
			
			// Response Command
			k_mutex_lock(&test_mutex, K_FOREVER); 	// A Reading of the RTDB is about to begin lets lock the access
			
			sprintf(resp, "b%d%d%d%d", database->but[0], database->but[1], database->but[2], database->but[3]);
			sprintf(checksum, "%03d", calcChecksum((unsigned char*)&(resp[0]), 5));
			sprintf(resp, "#b%d%d%d%d%s!", database->but[0], database->but[1], database->but[2], database->but[3], checksum);
			
			k_mutex_unlock(&test_mutex);			// Reading done, time to unlock
			
			return SUCCESS;	// case 'B'
		case 'L': // # L [1/2/3/4] [CS] ! - Toggle LED state (Ligado ou desligado)
			// Validate frame structure
			if(cmd[6] != EOF_SYM){
				return MISSING_EOF;
			}

			// Validate LED number (1 to 4)
			if(cmd[2] < '1' || cmd[2] > '4'){
				return UNKNOWN_LED;
			}
			
			// Validate checksum
			expectedChecksum = calcChecksum(&(cmd[1]), 2);
			sprintf(receivedChecksum, "%c%c%c", cmd[3], cmd[4], cmd[5]);
			if(atoi(receivedChecksum) != expectedChecksum){
				return WRONG_CS;
			}

			// Toggle LED
			k_mutex_lock(&test_mutex, K_FOREVER);

			database->led[cmd[2]-1-'0'] = database->led[cmd[2]-1-'0'] == 1 ? 0 : 1;
			var = database->led[cmd[2]-1-'0'];
			
			k_mutex_unlock(&test_mutex);

			// Response Command
			sprintf(resp, "l%c%d", cmd[2], var);
			sprintf(checksum, "%03d", calcChecksum((unsigned char*)&(resp[0]), 3));
			sprintf(resp, "#l%c%d%s!", cmd[2], var, checksum);

			return SUCCESS;	// case 'L'
		case 'A': // # A [CS] ! - Read Analog sensor (Temperatura)
			// Validate frame structure
			if(cmd[5] != EOF_SYM){
				return MISSING_EOF;
			}
			
			// Validate checksum
			expectedChecksum = calcChecksum(&(cmd[1]), 1);
			sprintf(receivedChecksum, "%c%c%c", cmd[2], cmd[3], cmd[4]);
			if(atoi(receivedChecksum) != expectedChecksum){
				return WRONG_CS;
			}

			// Read AnVal
			k_mutex_lock(&test_mutex, K_FOREVER);
			
			var = (int)database->anRaw;

			k_mutex_unlock(&test_mutex);

			// Response Command
			sprintf(resp, "a%04d", var);
			sprintf(checksum, "%03d", calcChecksum((unsigned char*)&(resp[0]), 5));
			sprintf(resp, "#a%04d%s!", var, checksum);

			return SUCCESS;	// case 'A'
		case 'U': // # U [00] [CS] ! - Change frequecy of update of the in/out digital signals of RTDB
			// Validate frame structure
			if(cmd[7] != EOF_SYM){
				return MISSING_EOF;
			}
			
			// Validate Frequecy value
			if(!isdigit(cmd[2]) || !isdigit(cmd[2])){
				return INVALID_FREQ;
			}

			// Validate checksum
			expectedChecksum = calcChecksum(&(cmd[1]), 3);
			sprintf(receivedChecksum, "%c%c%c", cmd[4], cmd[5], cmd[6]);
			if(atoi(receivedChecksum) != expectedChecksum){
				return WRONG_CS;
			}

			// Response Command
			var = ((cmd[2] - '0')*10 + (cmd[3] - '0'))*pow(10, 6); // New frequecy of update
			updateFreq(var);
			sprintf(resp, "u%c%c", cmd[2], cmd[3]);
			sprintf(checksum, "%03d", calcChecksum((unsigned char*)&(resp[0]), 3));
			sprintf(resp, "#u%c%c%s!", cmd[2], cmd[3], checksum);

			return SUCCESS;	// case 'U'
		default:
			return UNKNOWN_CMD;				
	}
	return MISSING_SOF;
}

unsigned char calcChecksum(unsigned char *buf, int nbytes){
	unsigned char checksum = 0;
	for(int i = 0; i < nbytes; i++){ // computing expected checksum
		checksum += buf[i];
	}

	return checksum;
}
```

## src/funcs.c
```c
/** @file funcs.c
 * 
 * @brief Implementation of some basic auxiliary functions
 * 
 * @author Gonçalo Peralta & João Alvares
 * @date 03 June 2024
 * @bug No known bugs.
 */
#include <zephyr/kernel.h>
#include <zephyr/device.h>
#include <zephyr/drivers/gpio.h>
#include <zephyr/sys/util.h>
#include <zephyr/sys/printk.h>

#include <stdlib.h>

#include "../includes/funcs.h"

void initRTDB(RTDB *rtdb){
    rtdb->led[0] = 0;
    rtdb->led[1] = 0;
    rtdb->led[2] = 0;
    rtdb->led[3] = 0;
    rtdb->but[0] = 0;
    rtdb->but[1] = 0;
    rtdb->but[2] = 0;
    rtdb->but[3] = 0;
    rtdb->anRaw = 0;
    rtdb->anVal = 0;
}

void consoleLog(int err){
    char errorLog[6][50] = {"Missing Start of frame '#'", "Missing Eof of frame '!'", "Wrong Checksum", "Invalid type not identified", "Invalid LED number", "Invalid Frequency"};
	printk("[LOG] Error in command structure: %s\n", errorLog[abs(err)-100]);
}
```

## src/main.h
```c
/** @file main.h
 * @brief
*/
#ifndef MAIN_H
#define MAIN_H

/**
 * @brief Real-time database
 * 
 * This database holds the LED and button state and the analog reader value.
 * 
 *  
*/
typedef struct{
    bool led[4];    /**< LEDs 1 to 4 state (1 for ON and 0 for OFF)*/
    bool but[4];    /**< Button 1 to 4 state (1 for pressed and 0 for not pressed)*/
    int anRaw;      /**< Raw value of the analog reader*/
    int anVal;      /**< Converted value of the analog reader*/
} RTDB;

#endif
```
